## conf/layer.conf
```bitbake
# We have a conf and classes directory, add to BBPATH
BBPATH .= ":${LAYERDIR}"

# We have recipes-* directories, add to BBFILES
BBFILES += "${LAYERDIR}/recipes-*/*/*.bb \
            ${LAYERDIR}/recipes-*/*/*.bbappend"

BBFILE_COLLECTIONS += "meta-phuclayer"
BBFILE_PATTERN_meta-phuclayer = "^${LAYERDIR}/"
BBFILE_PRIORITY_meta-phuclayer = "6"

LAYERDEPENDS_meta-phuclayer = "core"
LAYERSERIES_COMPAT_meta-phuclayer = "scarthgap"

# Let's add our hello world application to /usr/bin
IMAGE_INSTALL:append = " hello \
"

# add the feature :=> tools-sdk
EXTRA_IMAGE_FEATURES += "debug-tweaks tools-sdk"

PREFERRED_PROVIDER_virtual/libmath = "libmath"
PREFERRED_VERSION_libmath = "1.0"
```

## conf/machine/rock5b-plus.conf
```bitbake
# Rock 5B+ Machine Configuration
# Based on meta-rockchip rockchip-rk3588-rock-5b-plus.conf

require conf/machine/rockchip-rk3588-rock-5b-plus.conf

# Additional packages for Rock 5B+ development
IMAGE_INSTALL:append = " \
    i2c-tools \
    libgpiod \
    libgpiod-tools \
    python3 \
    python3-numpy \
    cmake \
    dropbear \
"

# Additional features for Rock 5B+
MACHINE_FEATURES += "usbhost usbgadget"

# Image types for Rock 5B+
IMAGE_FSTYPES = "tar.gz ext4 wic.bmap wic.gz"
```
